## configs/qemu_arm_vexpress_ostree_cpio_defconfig
```kconfig
BR2_arm=y
BR2_TOOLCHAIN_EXTERNAL=y
BR2_TARGET_GENERIC_GETTY_PORT="ttyAMA0"
BR2_SYSTEM_DHCP="eth0"
BR2_ROOTFS_OVERLAY="cpio-overlay"
BR2_LINUX_KERNEL=y
BR2_LINUX_KERNEL_CUSTOM_VERSION=y
BR2_LINUX_KERNEL_CUSTOM_VERSION_VALUE="4.8.1"
BR2_LINUX_KERNEL_DEFCONFIG="vexpress"
BR2_LINUX_KERNEL_DTS_SUPPORT=y
BR2_LINUX_KERNEL_INTREE_DTS_NAME="vexpress-v2p-ca9"
BR2_PACKAGE_XZ=y
BR2_PACKAGE_STRACE=y
BR2_PACKAGE_E2FSPROGS=y
BR2_PACKAGE_MTD=y
BR2_PACKAGE_LIBARCHIVE=y
BR2_PACKAGE_LIBARCHIVE_BSDTAR=y
BR2_PACKAGE_LIBARCHIVE_BSDCPIO=y
BR2_PACKAGE_LIBARCHIVE_BSDCAT=y
BR2_PACKAGE_LIBGPGME=y
BR2_PACKAGE_LIBFUSE=y
BR2_PACKAGE_LIBSOUP=y
BR2_PACKAGE_LIBSOUP_SSL=y
BR2_PACKAGE_OSTREE=y
BR2_TARGET_ROOTFS_CPIO=y
# BR2_TARGET_ROOTFS_TAR is not set
BR2_TARGET_UBOOT=y
BR2_TARGET_UBOOT_BUILD_SYSTEM_KCONFIG=y
BR2_TARGET_UBOOT_BOARD_DEFCONFIG="vexpress_ca9x4"
BR2_TARGET_UBOOT_FORMAT_ELF=y
BR2_PACKAGE_HOST_MKE2IMG=y
```

## configs/qemu_arm_vexpress_ostree_target_defconfig
```kconfig
BR2_arm=y
BR2_TOOLCHAIN_EXTERNAL=y
BR2_TARGET_GENERIC_GETTY_PORT="ttyAMA0"
BR2_SYSTEM_DHCP="eth0"
BR2_ROOTFS_OVERLAY="target-overlay"
BR2_LINUX_KERNEL=y
BR2_LINUX_KERNEL_CUSTOM_VERSION=y
BR2_LINUX_KERNEL_CUSTOM_VERSION_VALUE="4.8.1"
BR2_LINUX_KERNEL_DEFCONFIG="vexpress"
BR2_LINUX_KERNEL_DTS_SUPPORT=y
BR2_LINUX_KERNEL_INTREE_DTS_NAME="vexpress-v2p-ca9"
BR2_LINUX_KERNEL_INSTALL_TARGET=y
BR2_PACKAGE_XZ=y
BR2_PACKAGE_STRACE=y
BR2_PACKAGE_E2FSPROGS=y
BR2_PACKAGE_MTD=y
BR2_PACKAGE_LIBARCHIVE=y
BR2_PACKAGE_LIBARCHIVE_BSDTAR=y
BR2_PACKAGE_LIBARCHIVE_BSDCPIO=y
BR2_PACKAGE_LIBARCHIVE_BSDCAT=y
BR2_PACKAGE_LIBGPGME=y
BR2_PACKAGE_LIBFUSE=y
BR2_PACKAGE_LIBSOUP=y
BR2_PACKAGE_LIBSOUP_SSL=y
BR2_PACKAGE_OSTREE=y
BR2_TARGET_ROOTFS_CPIO=y
# BR2_TARGET_ROOTFS_TAR is not set
BR2_PACKAGE_HOST_MKE2IMG=y
```

## package/ostree/Config.in
```kconfig
config BR2_PACKAGE_OSTREE
	bool "ostree"
	depends on BR2_PACKAGE_LIBGLIB2 
	depends on BR2_PACKAGE_XZ
	depends on BR2_PACKAGE_E2FSPROGS
	depends on BR2_PACKAGE_LIBARCHIVE
	depends on BR2_PACKAGE_LIBSOUP
	depends on BR2_PACKAGE_LIBGPGME
	depends on BR2_PACKAGE_LIBFUSE
	help
	  A simple program to rotate logs.

	  https://fedorahosted.org/logrotate/
```

## package/qt-custom/Config.in
```kconfig
config BR2_PACKAGE_QT_CUSTOM
        bool "Qt (Custom LDC build)"
        help
          Our own repository using Qt5
```

## package/qtotaupdate/Config.in
```kconfig
config BR2_PACKAGE_QTOTAUPDATE
        bool "Qt OTA update"
        help
          Build Qt OTA update lib.
```
